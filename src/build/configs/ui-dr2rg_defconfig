## src/build/configs/ui-dr2rg_defconfig
```kconfig
CONFIG_MODEL_UIDR2RG=y
CONFIG_UBUNTU=y
CONFIG_UBUNTU_MAJOR_VER=20
CONFIG_UBUNTU_MINOR_VER=04
CONFIG_RSU=y
CONFIG_SQLITE=y
CONFIG_GPS_RSU=y
CONFIG_RSU_MAX_DEV=18
CONFIG_RTC=y
CONFIG_WEBSOCKET=y
CONFIG_EXT_DATA_FORMAT=y
CONFIG_SW_VERSION=2.1
```
